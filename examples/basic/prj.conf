## CMakeLists.txt
```
cmake_minimum_required(VERSION 3.20.0)

set(RT_LOG_DIR "${CMAKE_CURRENT_LIST_DIR}/../../../rt_log" CACHE PATH "Path to rt_log module")
set(RT_DIAGNOSTICS_DIR "${CMAKE_CURRENT_LIST_DIR}/../../../rt_diagnostics" CACHE PATH "Path to rt_diagnostics module")

list(APPEND ZEPHYR_EXTRA_MODULES
  "${RT_LOG_DIR}"
  "${RT_DIAGNOSTICS_DIR}"
)

find_package(Zephyr REQUIRED HINTS $ENV{ZEPHYR_BASE})
project(rt_diagnostics_basic)
target_sources(app PRIVATE src/main.c)
```

## prj.conf
```kconfig
CONFIG_LOG=y
CONFIG_LOG_MODE_DEFERRED=y
CONFIG_RT_LOG=y
CONFIG_RT_LOG_MAX_LEVEL=3
CONFIG_RT_LOG_DEFAULT_LEVEL=3
CONFIG_RT_DIAGNOSTICS=y
CONFIG_RT_DIAGNOSTICS_DETAILED_TIMING=y
CONFIG_MAIN_STACK_SIZE=2048
```

## src/main.c
```c
/* SPDX-License-Identifier: Apache-2.0 */
#include <zephyr/kernel.h>

#include <rt_diagnostics/diagnostics.h>
#include <rt_diagnostics/zephyr_clock.h>
#include <rt_log/log.h>

RT_LOG_MODULE_REGISTER(diag_example);

static struct rt_diag metrics;
static struct rt_diag_snapshot snapshot;

/** Zephyr application entry; external only. Initializes the owner, measures one
 * elapsed sleep per second and closes due windows. Calls collector APIs and
 * rt_log; failures return to Zephyr instead of using invalid snapshots.
 */
int main(void)
{
	const struct rt_diag_config config = {.window_us = 2000000, .event_count = 1};
	int rc = rt_diag_init(&metrics, &config, rt_diag_now_us());
	if (rc)
		return rc;

	for (;;) {
		rc = rt_diag_cycle_begin(&metrics, rt_diag_now_us());
		if (rc)
			return rc;

		k_msleep(2);
		rc = rt_diag_event(&metrics, 0, 1);
		if (rc)
			return rc;
		rc = rt_diag_cycle_end(&metrics, rt_diag_now_us());
		if (rc)
			return rc;

		int64_t now = rt_diag_now_us();
		if (rt_diag_snapshot_due(&metrics, now)) {
			rc = rt_diag_take_snapshot(&metrics, now, &snapshot);
			if (rc)
				return rc;

			RT_LOGI("EXAMPLE", "window=%llu duration_us=%llu cycles=%llu max_us=%llu",
				(unsigned long long)snapshot.window_id,
				(unsigned long long)snapshot.duration_us,
				(unsigned long long)snapshot.window.cycles,
				(unsigned long long)snapshot.window.processing.max_us);
		}
		k_msleep(1000);
	}
}
```
